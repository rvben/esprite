## tools/qemu/lvgl_demo/sdkconfig.defaults
```kconfig
# The esp_lcd_qemu_rgb driver busy-waits until the host consumes each frame
# (one QMP screendump = one consumed draw); that wait starves IDLE while a
# frame is pending, so the task watchdog is off, exactly like the rgb fixture.
CONFIG_ESP_TASK_WDT_INIT=n
# Full-frame LVGL buffer (150 KB) plus LVGL internals need the room; no
# networking in this firmware.
CONFIG_ESP_MAIN_TASK_STACK_SIZE=8192
```

## tools/qemu/rgb_demo/sdkconfig.defaults
```kconfig
# The esp_lcd_qemu_rgb driver busy-waits for the host console to consume each
# frame; headless that wait lasts until the next screendump and would starve
# the IDLE task into task-watchdog serial spam. The fixture has no other
# watchdog-worthy work, so disable it.
CONFIG_ESP_TASK_WDT_INIT=n
# The OpenCores ethernet the QEMU machine emulates (no real ESP32-C3 has it).
CONFIG_ETH_USE_OPENETH=y
```
